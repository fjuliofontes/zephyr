## boards/arm/atsamd21_control_hub/Kconfig.board
```kconfig
# ATSAMD21 Control Hub board configuration

# Copyright (c) 2020 Google LLC.
# SPDX-License-Identifier: Apache-2.0

config BOARD_ATSAMD21_CONTROL_HUB
	bool "ATSAMD21_CONTROL_HUB"
	depends on SOC_PART_NUMBER_SAMD21G18A
```

## boards/arm/atsamd21_control_hub/Kconfig.defconfig
```kconfig
# ATSAMD21 Control hub configuration

# Copyright (c) 2020 Google LLC.
# SPDX-License-Identifier: Apache-2.0

config BOARD
	default "atsamd21_control_hub"
	depends on BOARD_ATSAMD21_CONTROL_HUB
```

## boards/arm/atsamd21_control_hub/board.yml
```yaml
board:
  name: atsamd21_control_hub
  full_name: ATSAMD21 Control Hub
  vendor: atmel
  socs:
    - name: samd21j18a
```

## boards/arm/atsamd21_custom/Kconfig.board
```kconfig
# ATSAMD21 Custom board configuration

# Copyright (c) 2020 Google LLC.
# SPDX-License-Identifier: Apache-2.0

config BOARD_ATSAMD21_CUSTOM
	bool "ATSAMD21 CUSTOM"
	depends on SOC_PART_NUMBER_SAMD21G18A
```

## boards/arm/atsamd21_custom/Kconfig.defconfig
```kconfig
# ATSAMD21 Custom board configuration

# Copyright (c) 2020 Google LLC.
# SPDX-License-Identifier: Apache-2.0

config BOARD
	default "atsamd21_custom"
	depends on BOARD_ATSAMD21_CUSTOM
```

## boards/arm/atsamd21_rs485_ext/Kconfig.atsamd21_rs485_ext
```kconfig
# ATSAMD21 RS485 Extension Interface board configuration

# Copyright (c) 2020 Google LLC.
# SPDX-License-Identifier: Apache-2.0

config BOARD_ATSAMD21_RS485_EXT
	select SOC_SAMD21G18A
```

## boards/arm/atsamd21_rs485_ext/Kconfig.defconfig
```kconfig
# ATSAMD21 RS485 Extension Interface board configuration

# Copyright (c) 2020 Google LLC.
# SPDX-License-Identifier: Apache-2.0

config BOARD
	default "atsamd21_rs485_ext"
	depends on BOARD_ATSAMD21_RS485_EXT
```

## boards/arm/atsamd21_rs485_ext/board.yml
```yaml
board:
  name: atsamd21_rs485_ext
  full_name: ATSAMD21 RS485 Extension Interface
  vendor: atmel
  socs:
    - name: samd21g18a
```

## boards/arm/stm32l151_modpow/Kconfig.board
```kconfig
# Board configuration

# Copyright (c) 2019 eTactica ehf
# SPDX-License-Identifier: Apache-2.0

config BOARD_STM32L151_MODPOW
	bool "STM32L151 MODPOW Development Board"
	depends on SOC_STM32L151XB
```

## boards/arm/stm32l151_modpow/Kconfig.defconfig
```kconfig
# Board configuration

# Copyright (c) 2019 eTactica ehf
# SPDX-License-Identifier: Apache-2.0

if BOARD_STM32L151_MODPOW

config BOARD
	default "stm32l151_modpow"

endif # BOARD_STM32L151_MODPOW
```
